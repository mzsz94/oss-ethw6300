## boards/riscv/rp2350_w6300_evb/Kconfig.board
```kconfig
# SPDX-License-Identifier: Apache-2.0

config BOARD_RP2350_W6300_EVB
	bool "Raspberry Pi RP2350 W6300 EVB"
	depends on SOC_RP2350
```

## boards/wiznet/rp2350_w6300_evb/Kconfig.board
```kconfig
config BOARD_RP2350_W6300_EVB
	bool "Raspberry Pi RP2350 W6300 EVB"
	select SOC_RP2350A_HAZARD3
```

## boards/wiznet/rp2350_w6300_evb/Kconfig.defconfig
```kconfig
if BOARD_RP2350_W6300_EVB

config SYS_CLOCK_HW_CYCLES_PER_SEC
	default 150000000

endif # BOARD_RP2350_W6300_EVB
```

## boards/wiznet/rp2350_w6300_evb/board.yml
```yaml
board:
  name: rp2350_w6300_evb
  full_name: Raspberry Pi RP2350 W6300 EVB
  vendor: wiznet
  socs:
    - name: rp2350a
```

## build/Kconfig/Kconfig.shield.defconfig
```kconfig
osource "/home/suzinee_u/workspace/rpi-zephyr/ethw6300/boards/shields/*/Kconfig.defconfig"
```

## build/Kconfig/arch/Kconfig
```kconfig
# Load Zephyr Arch Kconfig descriptions.
osource "/home/suzinee_u/workspace/rpi-zephyr/zephyrproject/zephyr/arch/rx/Kconfig"
osource "/home/suzinee_u/workspace/rpi-zephyr/zephyrproject/zephyr/arch/x86/Kconfig"
osource "/home/suzinee_u/workspace/rpi-zephyr/zephyrproject/zephyr/arch/xtensa/Kconfig"
osource "/home/suzinee_u/workspace/rpi-zephyr/zephyrproject/zephyr/arch/sparc/Kconfig"
osource "/home/suzinee_u/workspace/rpi-zephyr/zephyrproject/zephyr/arch/riscv/Kconfig"
osource "/home/suzinee_u/workspace/rpi-zephyr/zephyrproject/zephyr/arch/posix/Kconfig"
osource "/home/suzinee_u/workspace/rpi-zephyr/zephyrproject/zephyr/arch/mips/Kconfig"
osource "/home/suzinee_u/workspace/rpi-zephyr/zephyrproject/zephyr/arch/arm64/Kconfig"
osource "/home/suzinee_u/workspace/rpi-zephyr/zephyrproject/zephyr/arch/arm/Kconfig"
osource "/home/suzinee_u/workspace/rpi-zephyr/zephyrproject/zephyr/arch/arc/Kconfig"
```

## build/Kconfig/boards/Kconfig.tmp
```kconfig
# Load Zephyr board Kconfig descriptions.
osource "/home/suzinee_u/workspace/rpi-zephyr/ethw6300/boards/wiznet/rp2350_w6300_evb/Kconfig"
```

## build/Kconfig/soc/Kconfig
```kconfig
# Load Zephyr SoC Kconfig descriptions.
osource "/home/suzinee_u/workspace/rpi-zephyr/zephyrproject/zephyr/soc/xlnx/zynqmp/Kconfig"
osource "/home/suzinee_u/workspace/rpi-zephyr/zephyrproject/zephyr/soc/xlnx/zynq7000/Kconfig"
osource "/home/suzinee_u/workspace/rpi-zephyr/zephyrproject/zephyr/soc/xlnx/versalnet/Kconfig"
osource "/home/suzinee_u/workspace/rpi-zephyr/zephyrproject/zephyr/soc/xlnx/versal2/Kconfig"
osource "/home/suzinee_u/workspace/rpi-zephyr/zephyrproject/zephyr/soc/xlnx/versal/Kconfig"
osource "/home/suzinee_u/workspace/rpi-zephyr/zephyrproject/zephyr/soc/xen/Kconfig"
osource "/home/suzinee_u/workspace/rpi-zephyr/zephyrproject/zephyr/soc/wch/ch32v/Kconfig"
osource "/home/suzinee_u/workspace/rpi-zephyr/zephyrproject/zephyr/soc/ti/simplelink/Kconfig"
osource "/home/suzinee_u/workspace/rpi-zephyr/zephyrproject/zephyr/soc/ti/mspm0/Kconfig"
osource "/home/suzinee_u/workspace/rpi-zephyr/zephyrproject/zephyr/soc/ti/lm3s6965/Kconfig"
osource "/home/suzinee_u/workspace/rpi-zephyr/zephyrproject/zephyr/soc/ti/k3/Kconfig"
osource "/home/suzinee_u/workspace/rpi-zephyr/zephyrproject/zephyr/soc/telink/tlsr/Kconfig"
osource "/home/suzinee_u/workspace/rpi-zephyr/zephyrproject/zephyr/soc/starfive/jh71xx/Kconfig"
osource "/home/suzinee_u/workspace/rpi-zephyr/zephyrproject/zephyr/soc/st/stm32/Kconfig"
osource "/home/suzinee_u/workspace/rpi-zephyr/zephyrproject/zephyr/soc/snps/qemu_arc/Kconfig"
osource "/home/suzinee_u/workspace/rpi-zephyr/zephyrproject/zephyr/soc/snps/nsim/arc_v/Kconfig"
osource "/home/suzinee_u/workspace/rpi-zephyr/zephyrproject/zephyr/soc/snps/nsim/arc_classic/Kconfig"
osource "/home/suzinee_u/workspace/rpi-zephyr/zephyrproject/zephyr/soc/snps/hsdk4xd/Kconfig"
osource "/home/suzinee_u/workspace/rpi-zephyr/zephyrproject/zephyr/soc/snps/hsdk/Kconfig"
osource "/home/suzinee_u/workspace/rpi-zephyr/zephyrproject/zephyr/soc/snps/emsk/Kconfig"
osource "/home/suzinee_u/workspace/rpi-zephyr/zephyrproject/zephyr/soc/snps/emsdp/Kconfig"
osource "/home/suzinee_u/workspace/rpi-zephyr/zephyrproject/zephyr/soc/snps/arc_iot/Kconfig"
osource "/home/suzinee_u/workspace/rpi-zephyr/zephyrproject/zephyr/soc/silabs/Kconfig"
osource "/home/suzinee_u/workspace/rpi-zephyr/zephyrproject/zephyr/soc/sifli/sf32/Kconfig"
osource "/home/suzinee_u/workspace/rpi-zephyr/zephyrproject/zephyr/soc/sifive/sifive_freedom/Kconfig"
osource "/home/suzinee_u/workspace/rpi-zephyr/zephyrproject/zephyr/soc/sensry/Kconfig"
osource "/home/suzinee_u/workspace/rpi-zephyr/zephyrproject/zephyr/soc/rockchip/Kconfig"
osource "/home/suzinee_u/workspace/rpi-zephyr/zephyrproject/zephyr/soc/renode/riscv_virtual/Kconfig"
osource "/home/suzinee_u/workspace/rpi-zephyr/zephyrproject/zephyr/soc/renode/cortex_r8_virtual/Kconfig"
osource "/home/suzinee_u/workspace/rpi-zephyr/zephyrproject/zephyr/soc/renesas/smartbond/Kconfig"
osource "/home/suzinee_u/workspace/rpi-zephyr/zephyrproject/zephyr/soc/renesas/rz/Kconfig"
osource "/home/suzinee_u/workspace/rpi-zephyr/zephyrproject/zephyr/soc/renesas/rx/Kconfig"
osource "/home/suzinee_u/workspace/rpi-zephyr/zephyrproject/zephyr/soc/renesas/rcar/Kconfig"
osource "/home/suzinee_u/workspace/rpi-zephyr/zephyrproject/zephyr/soc/renesas/ra/Kconfig"
osource "/home/suzinee_u/workspace/rpi-zephyr/zephyrproject/zephyr/soc/realtek/ec/Kconfig"
osource "/home/suzinee_u/workspace/rpi-zephyr/zephyrproject/zephyr/soc/realtek/ameba/Kconfig"
osource "/home/suzinee_u/workspace/rpi-zephyr/zephyrproject/zephyr/soc/raspberrypi/rpi_pico/Kconfig"
osource "/home/suzinee_u/workspace/rpi-zephyr/zephyrproject/zephyr/soc/quicklogic/eos_s3/Kconfig"
osource "/home/suzinee_u/workspace/rpi-zephyr/zephyrproject/zephyr/soc/qemu/virt_riscv/Kconfig"
osource "/home/suzinee_u/workspace/rpi-zephyr/zephyrproject/zephyr/soc/qemu/malta/Kconfig"
osource "/home/suzinee_u/workspace/rpi-zephyr/zephyrproject/zephyr/soc/openisa/rv32m1/Kconfig"
osource "/home/suzinee_u/workspace/rpi-zephyr/zephyrproject/zephyr/soc/openhwgroup/cva6/Kconfig"
osource "/home/suzinee_u/workspace/rpi-zephyr/zephyrproject/zephyr/soc/oct/osd32mp15x/Kconfig"
osource "/home/suzinee_u/workspace/rpi-zephyr/zephyrproject/zephyr/soc/nxp/s32/Kconfig"
osource "/home/suzinee_u/workspace/rpi-zephyr/zephyrproject/zephyr/soc/nxp/rw/Kconfig"
osource "/home/suzinee_u/workspace/rpi-zephyr/zephyrproject/zephyr/soc/nxp/mcx/Kconfig"
osource "/home/suzinee_u/workspace/rpi-zephyr/zephyrproject/zephyr/soc/nxp/lpc/Kconfig"
osource "/home/suzinee_u/workspace/rpi-zephyr/zephyrproject/zephyr/soc/nxp/layerscape/Kconfig"
osource "/home/suzinee_u/workspace/rpi-zephyr/zephyrproject/zephyr/soc/nxp/kinetis/Kconfig"
osource "/home/suzinee_u/workspace/rpi-zephyr/zephyrproject/zephyr/soc/nxp/imxrt/Kconfig"
osource "/home/suzinee_u/workspace/rpi-zephyr/zephyrproject/zephyr/soc/nxp/imx/Kconfig"
osource "/home/suzinee_u/workspace/rpi-zephyr/zephyrproject/zephyr/soc/nuvoton/numicro/Kconfig"
osource "/home/suzinee_u/workspace/rpi-zephyr/zephyrproject/zephyr/soc/nuvoton/numaker/Kconfig"
osource "/home/suzinee_u/workspace/rpi-zephyr/zephyrproject/zephyr/soc/nuvoton/npcx/Kconfig"
osource "/home/suzinee_u/workspace/rpi-zephyr/zephyrproject/zephyr/soc/nuvoton/npcm/Kconfig"
osource "/home/suzinee_u/workspace/rpi-zephyr/zephyrproject/zephyr/soc/nordic/Kconfig"
osource "/home/suzinee_u/workspace/rpi-zephyr/zephyrproject/zephyr/soc/neorv32/Kconfig"
osource "/home/suzinee_u/workspace/rpi-zephyr/zephyrproject/zephyr/soc/native/inf_clock/Kconfig"
osource "/home/suzinee_u/workspace/rpi-zephyr/zephyrproject/zephyr/soc/microchip/sam/sama7/Kconfig"
osource "/home/suzinee_u/workspace/rpi-zephyr/zephyrproject/zephyr/soc/microchip/sam/sam_d5x_e5x/Kconfig"
osource "/home/suzinee_u/workspace/rpi-zephyr/zephyrproject/zephyr/soc/microchip/pic32c/pic32cz_ca/Kconfig"
osource "/home/suzinee_u/workspace/rpi-zephyr/zephyrproject/zephyr/soc/microchip/pic32c/pic32cx_sg/Kconfig"
osource "/home/suzinee_u/workspace/rpi-zephyr/zephyrproject/zephyr/soc/microchip/pic32c/pic32cm_jh/Kconfig"
osource "/home/suzinee_u/workspace/rpi-zephyr/zephyrproject/zephyr/soc/microchip/miv/Kconfig"
osource "/home/suzinee_u/workspace/rpi-zephyr/zephyrproject/zephyr/soc/microchip/mec/Kconfig"
osource "/home/suzinee_u/workspace/rpi-zephyr/zephyrproject/zephyr/soc/mediatek/mt8xxx/Kconfig"
osource "/home/suzinee_u/workspace/rpi-zephyr/zephyrproject/zephyr/soc/lowrisc/opentitan/Kconfig"
osource "/home/suzinee_u/workspace/rpi-zephyr/zephyrproject/zephyr/soc/litex/litex_vexriscv/Kconfig"
osource "/home/suzinee_u/workspace/rpi-zephyr/zephyrproject/zephyr/soc/ite/ec/Kconfig"
osource "/home/suzinee_u/workspace/rpi-zephyr/zephyrproject/zephyr/soc/intel/wildcat_lake/Kconfig"
osource "/home/suzinee_u/workspace/rpi-zephyr/zephyrproject/zephyr/soc/intel/raptor_lake/Kconfig"
osource "/home/suzinee_u/workspace/rpi-zephyr/zephyrproject/zephyr/soc/intel/panther_lake/Kconfig"
osource "/home/suzinee_u/workspace/rpi-zephyr/zephyrproject/zephyr/soc/intel/lakemont/Kconfig"
osource "/home/suzinee_u/workspace/rpi-zephyr/zephyrproject/zephyr/soc/intel/intel_socfpga_std/Kconfig"
osource "/home/suzinee_u/workspace/rpi-zephyr/zephyrproject/zephyr/soc/intel/intel_socfpga/Kconfig"
osource "/home/suzinee_u/workspace/rpi-zephyr/zephyrproject/zephyr/soc/intel/intel_niosv/Kconfig"
osource "/home/suzinee_u/workspace/rpi-zephyr/zephyrproject/zephyr/soc/intel/intel_ish/Kconfig"
osource "/home/suzinee_u/workspace/rpi-zephyr/zephyrproject/zephyr/soc/intel/intel_adsp/Kconfig"
osource "/home/suzinee_u/workspace/rpi-zephyr/zephyrproject/zephyr/soc/intel/elkhart_lake/Kconfig"
osource "/home/suzinee_u/workspace/rpi-zephyr/zephyrproject/zephyr/soc/intel/atom/Kconfig"
osource "/home/suzinee_u/workspace/rpi-zephyr/zephyrproject/zephyr/soc/intel/apollo_lake/Kconfig"
osource "/home/suzinee_u/workspace/rpi-zephyr/zephyrproject/zephyr/soc/intel/alder_lake/Kconfig"
osource "/home/suzinee_u/workspace/rpi-zephyr/zephyrproject/zephyr/soc/infineon/psoc4/Kconfig"
osource "/home/suzinee_u/workspace/rpi-zephyr/zephyrproject/zephyr/soc/infineon/edge/Kconfig"
osource "/home/suzinee_u/workspace/rpi-zephyr/zephyrproject/zephyr/soc/infineon/cat3/Kconfig"
osource "/home/suzinee_u/workspace/rpi-zephyr/zephyrproject/zephyr/soc/infineon/cat1c/Kconfig"
osource "/home/suzinee_u/workspace/rpi-zephyr/zephyrproject/zephyr/soc/infineon/cat1b/Kconfig"
osource "/home/suzinee_u/workspace/rpi-zephyr/zephyrproject/zephyr/soc/infineon/cat1a/Kconfig"
osource "/home/suzinee_u/workspace/rpi-zephyr/zephyrproject/zephyr/soc/gd/gd32/Kconfig"
osource "/home/suzinee_u/workspace/rpi-zephyr/zephyrproject/zephyr/soc/gaisler/leon3/Kconfig"
osource "/home/suzinee_u/workspace/rpi-zephyr/zephyrproject/zephyr/soc/gaisler/gr716a/Kconfig"
osource "/home/suzinee_u/workspace/rpi-zephyr/zephyrproject/zephyr/soc/focaltech/Kconfig"
osource "/home/suzinee_u/workspace/rpi-zephyr/zephyrproject/zephyr/soc/espressif/Kconfig"
osource "/home/suzinee_u/workspace/rpi-zephyr/zephyrproject/zephyr/soc/ene/kb1200/Kconfig"
osource "/home/suzinee_u/workspace/rpi-zephyr/zephyrproject/zephyr/soc/ene/kb106x/Kconfig"
osource "/home/suzinee_u/workspace/rpi-zephyr/zephyrproject/zephyr/soc/elan/em32f967/Kconfig"
osource "/home/suzinee_u/workspace/rpi-zephyr/zephyrproject/zephyr/soc/egis/Kconfig"
osource "/home/suzinee_u/workspace/rpi-zephyr/zephyrproject/zephyr/soc/efinix/sapphire/Kconfig"
osource "/home/suzinee_u/workspace/rpi-zephyr/zephyrproject/zephyr/soc/cdns/xtensa_sample_controller/Kconfig"
osource "/home/suzinee_u/workspace/rpi-zephyr/zephyrproject/zephyr/soc/cdns/sample_controller32/Kconfig"
osource "/home/suzinee_u/workspace/rpi-zephyr/zephyrproject/zephyr/soc/cdns/dc233c/Kconfig"
osource "/home/suzinee_u/workspace/rpi-zephyr/zephyrproject/zephyr/soc/brcm/bcmvk/Kconfig"
osource "/home/suzinee_u/workspace/rpi-zephyr/zephyrproject/zephyr/soc/brcm/bcm2712/Kconfig"
osource "/home/suzinee_u/workspace/rpi-zephyr/zephyrproject/zephyr/soc/brcm/bcm2711/Kconfig"
osource "/home/suzinee_u/workspace/rpi-zephyr/zephyrproject/zephyr/soc/bflb/Kconfig"
osource "/home/suzinee_u/workspace/rpi-zephyr/zephyrproject/zephyr/soc/atmel/sam0/Kconfig"
osource "/home/suzinee_u/workspace/rpi-zephyr/zephyrproject/zephyr/soc/atmel/sam/Kconfig"
osource "/home/suzinee_u/workspace/rpi-zephyr/zephyrproject/zephyr/soc/aspeed/Kconfig"
osource "/home/suzinee_u/workspace/rpi-zephyr/zephyrproject/zephyr/soc/arm/Kconfig"
osource "/home/suzinee_u/workspace/rpi-zephyr/zephyrproject/zephyr/soc/arm/beetle/Kconfig"
osource "/home/suzinee_u/workspace/rpi-zephyr/zephyrproject/zephyr/soc/antmicro/myra/Kconfig"
osource "/home/suzinee_u/workspace/rpi-zephyr/zephyrproject/zephyr/soc/andestech/Kconfig"
osource "/home/suzinee_u/workspace/rpi-zephyr/zephyrproject/zephyr/soc/amd/acp_6_0/Kconfig"
osource "/home/suzinee_u/workspace/rpi-zephyr/zephyrproject/zephyr/soc/ambiq/Kconfig"
osource "/home/suzinee_u/workspace/rpi-zephyr/zephyrproject/zephyr/soc/allwinner/sun8i_h3/Kconfig"
osource "/home/suzinee_u/workspace/rpi-zephyr/zephyrproject/zephyr/soc/aesc/Kconfig"
osource "/home/suzinee_u/workspace/rpi-zephyr/zephyrproject/zephyr/soc/adi/max32/Kconfig"
```

## drivers/ethernet/Kconfig
```kconfig
# SPDX-License-Identifier: Apache-2.0

menuconfig ETH_W6300
	bool "Wiznet W6300 Ethernet driver"
	default y
	depends on SPI
	select ETHERNET
	help
	  Enable W6300 Ethernet driver.
```
